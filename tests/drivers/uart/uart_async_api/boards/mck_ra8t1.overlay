/*
 * Copyright (c) 2024 Renesas Electronics Corporation
 * SPDX-License-Identifier: Apache-2.0
 */

dut: &sci4 {
	current-speed = <115200>;
	pinctrl-0 = <&sci4_default>;
	pinctrl-names = "default";
	status = "okay";
};
