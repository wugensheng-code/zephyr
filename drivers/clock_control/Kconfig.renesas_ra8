## drivers/clock_control/Kconfig.renesas_ra8
```kconfig
# Copyright (c) 2024 Renesas Electronics Corporation
# SPDX-License-Identifier: Apache-2.0

config CLOCK_CONTROL_RENESAS_RA_CGC
	bool "RA CGC driver"
	default y
	depends on SOC_SERIES_RA8
	help
	  Enable support for Renesas RA CGC driver.
```

## drivers/flash/Kconfig.renesas_ra
```kconfig
# Renesas RA Family

# Copyright (c) 2024 Renesas Electronics Corporation
# SPDX-License-Identifier: Apache-2.0

config RA_FLASH_HP
	bool "RA flash driver"
	depends on DT_HAS_RENESAS_RA8_FLASH_CONTROLLER_ENABLED
	default y
	select FLASH_HAS_DRIVER_ENABLED
	select FLASH_PAGE_LAYOUT
	select FLASH_HAS_PAGE_LAYOUT
	select FLASH_HAS_EX_OP if (SOC_SERIES_RA8)
	select USE_RA_FSP_FLASH_HP
	help
		Enable flash driver for RA series


if RA_FLASH_HP

config FLASH_RA_WRITE_PROTECT
	bool "Extended operation for flash write protection control"
	depends on SOC_SERIES_RA8
	default y
	help
		Enables flash extended operation to enable/disable flash write
		protection from external devices.

config FLASH_RA_READ_PROTECT
	bool "Extended operation for flash read protection control"
	depends on SOC_SERIES_RA8
	default n
	help
		Enables flash extended operation to enable/disable flash read
		protection from external devices.

endif # RA_FLASH_HP
```

## drivers/flash/Kconfig.renesas_ra8_ospi
```kconfig
# STM32 Octo SPI flash driver configuration options

# Copyright (c) 2022 STMicroelectronics
# SPDX-License-Identifier: Apache-2.0

config FLASH_RA8_OSPI
	bool "RA8 Octo SPI Flash driver"
	default y
	depends on DT_HAS_RENESAS_RA_OSPI_NOR_ENABLED
	select FLASH_HAS_DRIVER_ENABLED
	select FLASH_JESD216
	select FLASH_HAS_PAGE_LAYOUT
	select FLASH_HAS_EXPLICIT_ERASE
	help
	  Enable OSPI-NOR support on the STM32 family of processors.
```

## drivers/memc/Kconfig.ra8
```kconfig
# Copyright (c) 2020 Teslabs Engineering S.L.
# SPDX-License-Identifier: Apache-2.0

config MEMC_RA8
	bool "RA8 Extern Bus Memory Controller"
	default y
	depends on DT_HAS_RENESAS_RA8_BUS_ENABLED
	help
	  Enable RA8 Flexible Memory Controller.

if MEMC_RA8

config MEMC_RA8_SDRAM
	bool "RA8 SDRAM controller"
	default y
	depends on DT_HAS_RENESAS_RA8_BUS_SDRAM_ENABLED
	help
	  Enable RA8 FMC SDRAM controller.

endif
```

## drivers/sdhc/Kconfig.ra8
```kconfig
# Copyright 2022, NXP
# SPDX-License-Identifier: Apache-2.0

DT_RA8_SDHI_HAS_DMA := $(dt_nodelabel_has_prop,sdhi,dmas)

config SDHC_RA8
	bool "RA8 SDHI Driver"
	default y
	depends on DT_HAS_RENESAS_RA8_SDHI_ENABLED
	select SDHC_SUPPORTS_NATIVE_MODE
	select DMA if $(DT_RA8_SDHI_HAS_DMA)
	select PINCTRL
	select USE_RA_FSP_SDHI
	help
	  Enable the RA8 Host controller driver

# if SDHC_RA8

# config MCUX_SDIF_DMA_SUPPORT
# 	bool "DMA support for MCUX SDIF driver"
# 	default y
# 	help
# 	  Enable DMA support for MCUX SDIF driver. May be disabled to reduce
# 	  footprint of driver.

# if MCUX_SDIF_DMA_SUPPORT

# # SDIF DMA needs 32 bit aligned buffers
# config SDHC_BUFFER_ALIGNMENT
# 	default 4

# config MCUX_SDIF_DMA_BUFFER_SIZE
# 	int "Size of DMA descriptor buffer in bytes"
# 	default 256
# 	help
# 	  Size of MCUX SDIF DMA descriptor buffer in bytes

# endif #MCUX_SDIF_DMA_SUPPORT

# endif #MCUX_SDIF
```

## dts/bindings/clock/renesas,ra-cgc-pclk.yaml
```yaml
# Copyright (c) 2024 Renesas Electronics Corporation
# SPDX-License-Identifier: Apache-2.0

description: Renesas RA clock control node (sub-clock)

compatible: "renesas,ra-cgc-pclk"

include: [clock-controller.yaml, base.yaml]

properties:
  clk_src:
    type: int
    required: true
  clk_div:
    type: int
    required: true
    description: Prescale divider to calculate the subclock frequency from the
                 system clock frequency.
  clk_out:
    type: int

  "#clock-cells":
    const: 2


clock-cells:
  - mstp
  - stop_bit
```

## dts/bindings/clock/renesas,ra-cgc-pll.yaml
```yaml
# Copyright (c) 2024 Renesas Electronics Corporation
# SPDX-License-Identifier: Apache-2.0

description: Renesas RA8 Clock Generation Circuit

compatible: "renesas,ra-cgc-pll"

include: [clock-controller.yaml, base.yaml]

properties:
  source:
    type: int
  div:
    type: int
  mul:
    type: array
  divp:
    type: int
  freqp:
    type: int
  divq:
    type: int
  freqq:
    type: int
  divr:
    type: int
  freqr:
    type: int

  "#clock-cells":
    const: 0
```

## dts/bindings/flash_controller/renesas,ra8-flash-controller.yaml
```yaml
# Copyright (c) 2024 Renesas Electronics Corporation
# SPDX-License-Identifier: Apache-2.0

description: Renesas RA8 family flash controller

compatible: "renesas,ra8-flash-controller"

include: flash-controller.yaml
```

## dts/bindings/sdhc/renesas,,ra8-sdhi.yaml
```yaml
# Copyright 2022, NXP
# SPDX-License-Identifier: Apache-2.0

description: renesas ra8 SD host controller

compatible: "renesas,ra8-sdhi"

include: [sdhc.yaml, pinctrl-device.yaml]

properties:
  channel:
    type: int
    required: true

  reg:
    required: true

  clocks:
    required: true

  # bus-width:
  #   type: int
  #   default: 1
  #   description: |
  #       bus width for SDMMC access, defaults to the minimum necessary
  #       number of bus lines
  #   enum:
  #     - 1
  #     - 4
  #     - 8

  pinctrl-0:
    required: true

  pinctrl-names:
    required: true

  interrupts:
    required: true

  interrupt-names:
    required: true
```

## soc/renesas/ra/ra8/Kconfig.soc
```kconfig
# Copyright (c) 2024 Renesas Electronics Corporation
# SPDX-License-Identifier: Apache-2.0


config SOC_SERIES_RA8
	bool
	select SOC_FAMILY_RENESAS_RA
	help
		Renesas RA8 series

config SOC_R7FA8M1AHECBD
	bool
	select SOC_SERIES_RA8
	help
		R7FA8M1AHECBD

config SOC_SERIES
	default "ra8" if SOC_SERIES_RA8

config SOC_R7FA8D1BHECBD
	bool
	select SOC_SERIES_RA8
	help
		R7FA8D1BHECBD

config SOC
	default "ra8m1" if SOC_R7FA8M1AHECBD
	default "ra8d1" if SOC_R7FA8D1BHECBD
```
